## conf/layer.conf
```bitbake
# We have a conf and classes directory, add to BBPATH
BBPATH .= ":${LAYERDIR}"

# We have recipes-* directories, add to BBFILES
BBFILES += "${LAYERDIR}/recipes-*/*/*.bb \
            ${LAYERDIR}/recipes-*/*/*.bbappend"

BBFILE_COLLECTIONS += "meta-cip-sr-common"
BBFILE_PATTERN_meta-cip-sr-common = "^${LAYERDIR}/"
BBFILE_PRIORITY_meta-cip-sr-common = "12"

LAYERDEPENDS_meta-cip-sr-common = "core"
LAYERSERIES_COMPAT_meta-cip-sr-common = "dunfell warrior"
```

## wic/n6gsdl.wks
```
# short-description: Create SD card image for SolidSense N6G/IN6G
# long-description: Create a partitioned SD card image for SolidSEnse N6G/IN6G
part / --source rootfs --ondisk mmcblk0 --fstype=ext4 --label root --active --align 2048
```
